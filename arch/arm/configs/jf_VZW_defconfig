## arch/arm/configs/jf_VZW_defconfig
```kconfig
CONFIG_MACH_JF_VZW=y
CONFIG_EXTRA_FIRMWARE="audience-es325-fw-vzw.bin"
CONFIG_VMWARE_MVP=y
```

## drivers/interceptor/Kconfig
```kconfig
config AUTHENTEC_VPNCLIENT_INTERCEPTOR
	bool "AuthenTec VPNClient Interceptor"
        default n
```
